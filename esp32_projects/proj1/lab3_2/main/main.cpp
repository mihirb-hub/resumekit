
#include <stdio.h> // Include standard I/O library for printf/snprintf functions
#include "sdkconfig.h" // Include the project configuration header generated by ESP-IDF
#include "freertos/FreeRTOS.h" // Include FreeRTOS base headers for system kernel functions
#include "freertos/task.h" // Include FreeRTOS task management for delays and loops
#include "esp_log.h" // Include ESP32 logging library for debugging output
#include "driver/i2c_master.h" // Include the new ESP-IDF I2C master driver
#include "DFRobot_LCD.h" // Include the custom DFRobot LCD driver header

static const char *TAG = "example"; // Define a tag for logging messages from this file

#define I2C_MASTER_SCL_IO           GPIO_NUM_8        // Set GPIO 8 as the I2C clock line
#define I2C_MASTER_SDA_IO           GPIO_NUM_7        // Set GPIO 7 as the I2C data line
#define I2C_MASTER_NUM              I2C_NUM_0         // Select I2C port 0 for the master controller
#define I2C_MASTER_FREQ_HZ          100000            // Set I2C bus speed to 100kHz (Standard Mode)
#define I2C_MASTER_TX_BUF_DISABLE   0                 // Disable internal hardware TX buffer (direct transmission)
#define I2C_MASTER_RX_BUF_DISABLE   0                 // Disable internal hardware RX buffer
#define I2C_MASTER_TIMEOUT_MS       1000              // Define a 1-second timeout for I2C operations

#define SHTC3_SENSOR_ADDR           0x70 // I2C address for the SHTC3 Temperature/Humidity sensor
#define LCD_ADDRESS                 0x3E // I2C address for the LCD character display logic
#define RGB_ADDRESS                 0x60 // I2C address for the LCD RGB backlight controller
#define SHTC3_CMD_SLEEP_MSB         0xB0 // Most Significant Byte for SHTC3 sleep command
#define SHTC3_CMD_SLEEP_LSB         0x98 // Least Significant Byte for SHTC3 sleep command
#define SHTC3_CMD_WAKEUP_MSB        0x35 // Most Significant Byte for SHTC3 wakeup command
#define SHTC3_CMD_WAKEUP_LSB        0x17 // Least Significant Byte for SHTC3 wakeup command
#define SHTC3_CMD_SOFTRESET_MSB     0x80 // Most Significant Byte for SHTC3 software reset
#define SHTC3_CMD_SOFTRESET_LSB     0X5D // Least Significant Byte for SHTC3 software reset
#define SHTC3_CMD_MEASURE_MSB       0X7C // Most Significant Byte for measurement (Clock stretching disabled)
#define SHTC3_CMD_MEASURE_LSB       0xA2 // Least Significant Byte for measurement (Clock stretching disabled)

// Function to wake up the sensor from its low-power state
static esp_err_t shtc3_wakeup(i2c_master_dev_handle_t dev_handle){
   uint8_t cmd[2] = {SHTC3_CMD_WAKEUP_MSB, SHTC3_CMD_WAKEUP_LSB}; // Assemble the 16-bit wakeup command
   esp_err_t ret = i2c_master_transmit(dev_handle, cmd, 2, I2C_MASTER_TIMEOUT_MS); // Transmit command to sensor
   if (ret != ESP_OK){ // Check if the I2C transmission failed
       return ret; // Return the error code immediately
   }
   vTaskDelay(pdMS_TO_TICKS(200)); // Wait 200ms to allow the sensor crystal to stabilize
   return ESP_OK; // Return success
}

// Function to put the sensor back into low-power mode
static esp_err_t shtc3_sleep(i2c_master_dev_handle_t dev_handle){
   uint8_t cmd[2] = {SHTC3_CMD_SLEEP_MSB, SHTC3_CMD_SLEEP_LSB}; // Assemble the 16-bit sleep command
   vTaskDelay(pdMS_TO_TICKS(2)); // Short delay before sleep to ensure previous operations finished
   return i2c_master_transmit(dev_handle, cmd, 2, I2C_MASTER_TIMEOUT_MS); // Transmit sleep command
}

// Function to trigger a software reset on the sensor
static esp_err_t shtc3_soft_reset(i2c_master_dev_handle_t dev_handle){
   uint8_t cmd[2] = {SHTC3_CMD_SOFTRESET_MSB, SHTC3_CMD_SOFTRESET_LSB}; // Assemble the reset command
   esp_err_t ret = i2c_master_transmit(dev_handle, cmd, 2, I2C_MASTER_TIMEOUT_MS); // Transmit reset command
   if(ret != ESP_OK){ // Handle communication failure
       return ret; // Return the specific ESP error
   }
   vTaskDelay(pdMS_TO_TICKS(20)); // Wait 20ms for the sensor to reboot
   return ESP_OK; // Return success
}

// Function to start a measurement cycle
static esp_err_t shtc3_measurement(i2c_master_dev_handle_t dev_handle){
   uint8_t cmd[2] = {SHTC3_CMD_MEASURE_MSB, SHTC3_CMD_MEASURE_LSB}; // Assemble measurement command
   esp_err_t ret = i2c_master_transmit(dev_handle, cmd, 2, I2C_MASTER_TIMEOUT_MS); // Start measurement
   if (ret != ESP_OK) { // Handle transmission error
       return ret; // Return error
   }
   vTaskDelay(pdMS_TO_TICKS(200)); // Wait for measurement to complete (internal sensor timing)
   return ESP_OK; // Return success
}

// Function to calculate CRC8 for SHTC3 data verification
static uint8_t shtc3_crc8(const uint8_t *data, int len){
   uint8_t crc = 0xFF; // Initialize CRC register with 0xFF
   for (int i = 0; i < len; i++){ // Iterate through each data byte
       crc ^= data[i]; // XOR the current byte into the CRC register
       for (int j = 0; j < 8; j++){ // Process each of the 8 bits
           if(crc & 0x80){ // If the highest bit is set
               crc = (crc << 1) ^ 0x31; // Shift left and XOR with polynomial 0x31
           }
           else{ // If the highest bit is not set
               crc <<= 1; // Simply shift left
           }
       }
   }
   return crc; // Return the final calculated checksum
}

// Function to read back the 6 bytes of measurement data (Temp + CRC, Hum + CRC)
static esp_err_t shtc3_read_measurement(i2c_master_dev_handle_t shtc3_handle, uint16_t *raw_humidity, uint16_t *raw_temperature){
   uint8_t data[6]; // Buffer to hold 2 bytes Temp, 1 byte CRC, 2 bytes Hum, 1 byte CRC
   esp_err_t ret = i2c_master_receive(shtc3_handle, data, 6, I2C_MASTER_TIMEOUT_MS); // Receive 6 bytes over I2C
   if(ret != ESP_OK){ // Check if read failed
       return ret; // Return error
   }
   if(shtc3_crc8(&data[0], 2) != data[2]){ // Verify temperature data against its checksum
       ESP_LOGE(TAG, "Humidity CRC failed"); // Log error (Note: logic implies Temp index, but check is performed)
       return ESP_FAIL; // Return failure if CRC mismatch
   }
   if(shtc3_crc8(&data[3], 2) != data[5]){ // Verify humidity data against its checksum
       ESP_LOGE(TAG, "Temperature CRC failed"); // Log error
       return ESP_FAIL; // Return failure if CRC mismatch
   }

   *raw_temperature = ((uint16_t)data[0] << 8) | data[1]; // Combine high and low bytes for temperature
   *raw_humidity = ((uint16_t)data[3] << 8) | data[4]; // Combine high and low bytes for humidity

   return ESP_OK; // Return success
}

// Math to convert 16-bit raw humidity to percentage
static float shtc3_raw_to_humidity(uint16_t raw_humidity){
   return 100.0f * ((float)raw_humidity / 65536.0f); // Apply formula: RH = 100 * (SRH / 2^16)
}

// Math to convert 16-bit raw temperature to Celsius
static float shtc3_raw_to_temp_c(uint16_t raw_temperature){
   return -45.0f + 175.0f * ((float)raw_temperature / 65536.0f); // Apply formula: T = -45 + 175 * (ST / 2^16)
}

// Math to convert Celsius to Fahrenheit
static float shtc3_temp_c_to_f(float temp_c){
   return (temp_c * 9.0f / 5.0f) + 32.0f; // Apply standard C to F conversion formula
}

// Initialize the I2C master bus and add the three specific slave devices
static void i2c_master_init(i2c_master_bus_handle_t *bus_handle,
           i2c_master_dev_handle_t *shtc3_handle,
           i2c_master_dev_handle_t *lcd_handle,
           i2c_master_dev_handle_t *rgb_handle)
{
       i2c_master_bus_config_t bus_config = { // Structure for bus-wide settings
           I2C_MASTER_NUM, // Set port
           I2C_MASTER_SDA_IO, // Set SDA pin
           I2C_MASTER_SCL_IO, // Set SCL pin
           I2C_CLK_SRC_DEFAULT, // Use default clock source
           7, // Set glitch filter threshold
           0, // No intr_priority specified
           0, // Transmit buffer depth
           {true, // Enable internal pullup (logical true)
       false} // Disable clk_source_160m
       };

       ESP_ERROR_CHECK(i2c_new_master_bus(&bus_config, bus_handle)); // Create the I2C bus

       i2c_device_config_t dev_config = { // Template for device-specific settings
           I2C_ADDR_BIT_LEN_7, // Use 7-bit addressing
           SHTC3_SENSOR_ADDR, // Initial target address (SHTC3)
           I2C_MASTER_FREQ_HZ, // Use 100kHz clock speed
       0, // No specific SCL speed
       {} // No specific flags
       };
   dev_config.device_address = SHTC3_SENSOR_ADDR; // Explicitly set address for sensor
       ESP_ERROR_CHECK(i2c_master_bus_add_device(*bus_handle, &dev_config, shtc3_handle)); // Register SHTC3 device

   dev_config.device_address = LCD_ADDRESS; // Change address for LCD
       ESP_ERROR_CHECK(i2c_master_bus_add_device(*bus_handle, &dev_config, lcd_handle)); // Register LCD device

   dev_config.device_address = RGB_ADDRESS; // Change address for Backlight
       ESP_ERROR_CHECK(i2c_master_bus_add_device(*bus_handle, &dev_config, rgb_handle)); // Register Backlight device
}

extern "C" void app_main(void) // Entry point for ESP32 application
{
   i2c_master_bus_handle_t bus_handle; // Handle for the I2C bus
   i2c_master_dev_handle_t shtc3_handle; // Handle for sensor device
   i2c_master_dev_handle_t lcd_handle; // Handle for LCD device
   i2c_master_dev_handle_t rgb_handle; // Handle for Backlight device

   i2c_master_init(&bus_handle, &shtc3_handle, &lcd_handle, &rgb_handle); // Initialize hardware
   ESP_LOGI(TAG, "I2C initalized successfully"); // Log initialization status
   DFRobot_LCD lcd (lcd_handle, rgb_handle); // Instantiate the LCD object with device handles
   lcd.init(); // Initialize LCD controller settings and backlight
   char line1[17], line2[17]; // Create buffers for two rows of text (16 chars + null)
   uint16_t raw_humidity = 0; // Variable for raw humidity data
   uint16_t raw_temperature = 0; // Variable for raw temperature data
   float humidity = 0; // Variable for processed humidity
   float temp_c = 0.0f; // Variable for processed Celsius
   float temp_f = 0.0f; // Variable for processed Fahrenheit
   while(1){ // Main infinite execution loop

       esp_err_t ret; // Variable to store return status

       // Wake up the SHTC3 sensor
       ret = shtc3_wakeup(shtc3_handle); // Call wakeup function
       if (ret != ESP_OK){ // If wakeup fails
           ESP_LOGE(TAG, "Wakeup failed %s", esp_err_to_name(ret)); // Log the error
           vTaskDelay(pdMS_TO_TICKS(1000)); // Wait 1 second before retrying
           continue; // Restart the loop
       }

       // Start measurement cycle
       ret = shtc3_measurement(shtc3_handle); // Call measurement function
       if (ret != ESP_OK){ // If measurement start fails
           ESP_LOGE(TAG, "Measurement start failed %s", esp_err_to_name(ret)); // Log error
           esp_err_t reset_ret = shtc3_soft_reset(shtc3_handle); // Try to reset the sensor
           if(reset_ret != ESP_OK){ // If reset also fails
               ESP_LOGE(TAG, "Soft reset failed %s", esp_err_to_name(reset_ret)); // Log reset error
           }
           vTaskDelay(pdMS_TO_TICKS(1000)); // Wait before retry
           continue; // Restart loop
       }

       // Read measurement data from sensor
       ret = shtc3_read_measurement(shtc3_handle, &raw_humidity, &raw_temperature); // Retrieve raw data
       if(ret != ESP_OK){ // If read fails
           ESP_LOGE(TAG, "Measurement read failed: %s", esp_err_to_name(ret)); // Log error
           shtc3_sleep(shtc3_handle); // Attempt to put sensor to sleep to clear state
           vTaskDelay(pdMS_TO_TICKS(1000)); // Wait before retry
           continue; // Restart loop
       }


      ret = shtc3_sleep(shtc3_handle); // Put sensor in sleep mode until next cycle
      if (ret != ESP_OK){ // If sleep command fails
          ESP_LOGE(TAG, "Sleep failed: %s", esp_err_to_name(ret)); // Log error
      }

       humidity = shtc3_raw_to_humidity(raw_humidity); // Convert raw bits to %RH
       temp_c = shtc3_raw_to_temp_c(raw_temperature); // Convert raw bits to Celsius
       temp_f = shtc3_temp_c_to_f(temp_c); // Calculate Fahrenheit (calculated but not displayed below)

       snprintf(line1, sizeof(line1), "TemTemp: %.1fC", temp_c); // Format temperature string for row 1
       snprintf(line2, sizeof(line2), "Hum : %.0f%%", humidity); // Format humidity string for row 2
       lcd.clear(); // Clear old data from the LCD
       lcd.setCursor(0,3); // Move cursor (Note: row '3' is likely out of range for a 2-line LCD, but kept as provided)
       lcd.printstr(line1); // Print the temperature string
       lcd.setCursor(0,1); // Move cursor to the second row (index 1)
       lcd.printstr(line2); // Print the humidity string
      
       vTaskDelay(pdMS_TO_TICKS(1000)); // Pause for 1 second before the next sensor reading
   }
}

